## conf/layer.conf
```bitbake
# We have a conf and classes directory, add to BBPATH
BBPATH .= ":${LAYERDIR}"

# We have recipes-* directories, add to BBFILES
BBFILES += "${LAYERDIR}/recipes*/*/*.bb*"

BBFILE_COLLECTIONS += "personal"
BBFILE_PATTERN_personal = "^${LAYERDIR}/"
BBFILE_PRIORITY_personal = "1"

# This should only be incremented on significant changes that will
# cause compatibility issues with other layers
LAYERVERSION_personal = "1"

LAYERDEPENDS_personal = "core"

IMAGE_INSTALL_append = " hellotest"

IMAGE_INSTALL_append = " openvpn picocom nano iperf3 tcpdump watchdog netcat lzo strace ltrace"

IMAGE_INSTALL_remove = "qca9377-bt-firmware wl18xx-firmware"

INHERIT += "extrausers"
EXTRA_USERS_PARAMS = "usermod -P root root;"
AUTOLOGIN_TARGETS += "getty@ttyS0.service"
```
